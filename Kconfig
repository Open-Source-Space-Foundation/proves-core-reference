## modules/kleo-ina260/Kconfig
```kconfig
config KLEO_INA260
    bool "KLEO INA260 power monitor"
    default y
    depends on SENSOR && DT_HAS_TI_INA260_ENABLED
    select I2C
```

## modules/kleo-ina260/dts/bindings/sensor/ti,ina260.yaml
```yaml
description: Texas Instruments INA260 integrated-shunt power monitor
compatible: "ti,ina260"
include: [sensor-device.yaml, i2c-device.yaml]
```

## sim/dts/bindings/gpio/proves,gpio-latch-sim.yaml
```yaml
description: |
  Stand-in for the flight board's MCP23017 expander on native_sim.
  Reading a pin returns its output latch, as reading the MCP23017 GPIO
  register does. gpio-emul returns 0 for output-only pins instead.

compatible: "proves,gpio-latch-sim"

include: [gpio-controller.yaml, base.yaml]

properties:
  "#gpio-cells":
    const: 2

gpio-cells:
  - pin
  - flags
```

## sim/dts/bindings/lora/proves,lora-sim.yaml
```yaml
description: Null LoRa radio for native_sim. Sends are dropped and nothing is received.

compatible: "proves,lora-sim"

include: base.yaml
```

## sim/dts/bindings/rtc/proves,rtc-sim.yaml
```yaml
description: Emulated RV3028 stand-in for native_sim (Zephyr rtc-emul with flight-like callbacks and timing).

compatible: "proves,rtc-sim"

include: rtc-device.yaml
```

## sim/dts/bindings/sensor/proves,ina219-sim.yaml
```yaml
description: |
  Fake INA219 for native_sim. Serves SENSOR_CHAN_VOLTAGE, _CURRENT
  and _POWER. Each sample reads sim-file (host path, relative to the sim's
  working directory) as "<millivolts> [<milliamps>]"; when the file is absent
  or unparsable it reports the defaults.

compatible: "proves,ina219-sim"

include: i2c-device.yaml

properties:
  sim-file:
    type: string
    required: true
  default-millivolts:
    type: int
    required: true
  default-milliamps:
    type: int
    required: true
```

## sim/dts/bindings/sensor/proves,sensor-sim.yaml
```yaml
description: |
  Fake sensor for native_sim. Serves the quantities the node lists, each a
  default in micro-units of the Zephyr sensor API: accel (m/s^2, X Y Z),
  gyro (rad/s, X Y Z), magn (gauss, X Y Z), die-temp (degrees C),
  voltage (V) and current (A). A node with both voltage and current also
  serves SENSOR_CHAN_POWER as their product. Each sample reads sim-file
  (host path, relative to the sim's working directory), one
  "<quantity> <value>..." line per quantity in SI units, for example
  "gyro 0.1 0 0". Quantities the file leaves out, or all of them when the
  file is absent, report the defaults.

compatible: "proves,sensor-sim"

include: base.yaml

properties:
  sim-file:
    type: string
    required: true
  accel:
    type: array
  gyro:
    type: array
  magn:
    type: array
  die-temp:
    type: array
  voltage:
    type: array
  current:
    type: array
```

## sim/dts/bindings/watchdog/proves,watchdog-sim.yaml
```yaml
description: |
  Fake external watchdog for native_sim. Watches wdi-gpios, the pin the
  Watchdog component toggles, and cold-reboots the sim when the pin has not
  changed for timeout-ms.

compatible: "proves,watchdog-sim"

include: base.yaml

properties:
  wdi-gpios:
    type: phandle-array
    required: true
  timeout-ms:
    type: int
    required: true
```
