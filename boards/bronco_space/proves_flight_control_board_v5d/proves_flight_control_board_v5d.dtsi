#include <freq.h>

#include <zephyr/dt-bindings/i2c/i2c.h>
#include <zephyr/dt-bindings/pwm/pwm.h>

#include "../proves_flight_control_board_v5c/proves_flight_control_board_v5c.dtsi"
#include "../proves_flight_control_board_v5c/proves_flight_control_board_v5c-pinctrl.dtsi"

&led0 {
	gpios = <&gpio0 23 GPIO_ACTIVE_HIGH>;
	label = "User LED GPIO23";
};
