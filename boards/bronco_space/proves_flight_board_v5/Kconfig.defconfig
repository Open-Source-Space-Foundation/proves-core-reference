## boards/bronco_space/proves_flight_board_v5/Kconfig.defconfig
```kconfig
# Copyright (c) 2024 Andrew Featherstone
# SPDX-License-Identifier: Apache-2.0

if BOARD_PROVES_FLIGHT_BOARD_V5

config USB_SELF_POWERED
	default n

config USB_CDC_ACM_LOG_LEVEL
	default 0

config USB_DEVICE_LOG_LEVEL
	default 1
endif # BOARD_RPI_PICO2
```

## boards/bronco_space/proves_flight_board_v5/Kconfig.proves_flight_board_v5
```kconfig
# Copyright (c) 2024 Andrew Featherstone
# SPDX-License-Identifier: Apache-2.0

config BOARD_PROVES_FLIGHT_BOARD_V5
	select SOC_RP2350A_M33 if BOARD_PROVES_FLIGHT_BOARD_V5_RP2350A_M33
```

## boards/bronco_space/proves_flight_board_v5/board.yml
```yaml
board:
  name: proves_flight_board_v5
  full_name: Raspberry Pi Pico 2
  vendor: bronco_space
  socs:
  - name: rp2350a
```

## boards/bronco_space/proves_flight_board_v5/proves_flight_board_v5_rp2350a_m33_defconfig
```kconfig
CONFIG_BUILD_OUTPUT_HEX=y
CONFIG_BUILD_OUTPUT_UF2=y
CONFIG_CLOCK_CONTROL=y
CONFIG_CONSOLE=y
CONFIG_GPIO=y
CONFIG_RESET=y
CONFIG_SERIAL=y
CONFIG_UART_CONSOLE=y
CONFIG_UART_INTERRUPT_DRIVEN=y
CONFIG_USE_DT_CODE_PARTITION=y
CONFIG_USB_DEVICE_STACK=y
CONFIG_USB_DEVICE_PRODUCT="Pleiades Flight Board v5"
CONFIG_USB_DEVICE_VID=0x0028
```

## boards/bronco_space/proves_flight_control_board_v4b/Kconfig.proves_flight_control_board_v4b
```kconfig
config SOC_RP2040
    bool "Enable Cortex-M0+ core"
    default y

config USB_SELF_POWERED
	default n

config USB_CDC_ACM_LOG_LEVEL
	default 0

config USB_DEVICE_LOG_LEVEL
	default 1
```

## boards/bronco_space/proves_flight_control_board_v4b/board.yml
```yaml
board:
  name: proves_flight_control_board_v4b
  full_name: PROVES Flight Control Board v4b
  vendor: Bronco Space
  socs:
  - name: rp2340
```

## boards/bronco_space/proves_flight_control_board_v5/Kconfig.defconfig
```kconfig
config SOC_RP2350A_M33
    bool "Enable Arm cores"
    default y

config USB_SELF_POWERED
	default n

config USB_CDC_ACM_LOG_LEVEL
	default 0

config USB_DEVICE_LOG_LEVEL
	default 1
```

## boards/bronco_space/proves_flight_control_board_v5c/Kconfig.proves_flight_control_board_v5c
```kconfig
source "/Users/aychar/code/proves-core-reference/boards/bronco_space/proves_flight_control_board_v5/Kconfig.defconfig"
```

## boards/bronco_space/proves_flight_control_board_v5c/board.yml
```yaml
board:
  name: proves_flight_control_board_v5c
  full_name: PROVES Flight Control Board v5c
  vendor: Bronco Space
  socs:
  - name: rp2350a
```

## boards/bronco_space/proves_flight_control_board_v5c/proves_flight_control_board_v5c_rp2350a_m33_defconfig
```kconfig
CONFIG_BUILD_OUTPUT_HEX=y
CONFIG_BUILD_OUTPUT_UF2=y
CONFIG_CLOCK_CONTROL=y
CONFIG_CONSOLE=y
CONFIG_GPIO=y
CONFIG_RESET=y
CONFIG_SERIAL=y
CONFIG_UART_CONSOLE=y
CONFIG_UART_INTERRUPT_DRIVEN=y
CONFIG_USE_DT_CODE_PARTITION=y

# USB Next Stack
CONFIG_USBD_CDC_ACM_CLASS=y
CONFIG_USB_DEVICE_STACK_NEXT=y
CONFIG_CDC_ACM_SERIAL_ENABLE_AT_BOOT=y
CONFIG_CDC_ACM_SERIAL_INITIALIZE_AT_BOOT=y
CONFIG_CDC_ACM_SERIAL_PID=0x000F
CONFIG_CDC_ACM_SERIAL_VID=0x0028
CONFIG_CDC_ACM_SERIAL_PRODUCT_STRING="PROVES Flight Control Board v5c"
CONFIG_I2C_TCA954X=y
CONFIG_I2C_TCA954X_ROOT_INIT_PRIO=70
CONFIG_I2C_TCA954X_CHANNEL_INIT_PRIO=71

# Sensors
CONFIG_LSM6DSO=y
CONFIG_LSM6DSO_ENABLE_TEMP=y
CONFIG_LIS2MDL=y
CONFIG_INA219=y
CONFIG_TMP112=y
CONFIG_VEML6031=y

# Radio
CONFIG_LORA=y
CONFIG_LORA_SX127X=y

# RTC
CONFIG_RTC=y
CONFIG_RTC_RV3028=y

# Bootloader settings
CONFIG_BOOTLOADER_MCUBOOT=y
CONFIG_MCUBOOT_BOOTUTIL_LIB=y
# Use an offset to swap images
CONFIG_MCUBOOT_BOOTLOADER_MODE_SWAP_USING_OFFSET=y
# Allow downgrade (fallback)
CONFIG_MCUBOOT_BOOTLOADER_NO_DOWNGRADE=n
# Hyper important. Adjust and fail.
CONFIG_ROM_END_OFFSET=0x1150
CONFIG_MCUBOOT_UPDATE_FOOTER_SIZE=0x1000

# Settings to allow flash image writes
CONFIG_FLASH=y
CONFIG_FLASH_MAP=y
CONFIG_STREAM_FLASH=y
CONFIG_IMG_MANAGER=y
```

## boards/bronco_space/proves_flight_control_board_v5d/Kconfig.defconfig
```kconfig
# Copyright (c) 2024 Andrew Featherstone
# SPDX-License-Identifier: Apache-2.0

if PROVES_FLIGHT_CONTROL_BOARD_V5D

config USB_SELF_POWERED
	default n

config USB_CDC_ACM_LOG_LEVEL
	default 0

config USB_DEVICE_LOG_LEVEL
	default 1
endif # PROVES_FLIGHT_CONTROL_BOARD_V5D
```

## boards/bronco_space/proves_flight_control_board_v5d/Kconfig.proves_flight_control_board_v5d
```kconfig
config BOARD_PROVES_FLIGHT_CONTROL_BOARD_V5D
	bool "PROVES Flight Control Board v5d"
	default y

source "../../../boards/bronco_space/proves_flight_control_board_v5/Kconfig.defconfig"
```

## boards/bronco_space/proves_flight_control_board_v5d/board.yml
```yaml
board:
  name: proves_flight_control_board_v5d
  full_name: PROVES Flight Control Board v5d
  vendor: Bronco Space
  socs:
  - name: rp2350a
```

## boards/bronco_space/proves_flight_control_board_v5e/Kconfig.proves_flight_control_board_v5e
```kconfig
config BOARD_PROVES_FLIGHT_CONTROL_BOARD_V5E
	bool "PROVES Flight Control Board v5e"
	default y

rsource "../../../boards/bronco_space/proves_flight_control_board_v5/Kconfig.defconfig"
```

## boards/bronco_space/proves_flight_control_board_v5e/board.yml
```yaml
board:
  name: proves_flight_control_board_v5e
  full_name: PROVES Flight Control Board v5e
  vendor: The Spacecraft Company LLC
  socs:
  - name: rp2350a
```

## boards/bronco_space/proves_flight_control_board_v5e/proves_flight_control_board_v5e_rp2350a_m33_defconfig
```kconfig
CONFIG_BUILD_OUTPUT_HEX=y
CONFIG_BUILD_OUTPUT_UF2=y
CONFIG_CLOCK_CONTROL=y
CONFIG_CONSOLE=y
CONFIG_GPIO=y
CONFIG_RESET=y
CONFIG_SERIAL=y
CONFIG_UART_CONSOLE=y
CONFIG_UART_INTERRUPT_DRIVEN=y
CONFIG_USE_DT_CODE_PARTITION=y

# USB Next Stack
CONFIG_USBD_CDC_ACM_CLASS=y
CONFIG_USB_DEVICE_STACK_NEXT=y
CONFIG_CDC_ACM_SERIAL_ENABLE_AT_BOOT=y
CONFIG_CDC_ACM_SERIAL_INITIALIZE_AT_BOOT=y
CONFIG_CDC_ACM_SERIAL_PID=0x000F
CONFIG_CDC_ACM_SERIAL_VID=0x0028
CONFIG_CDC_ACM_SERIAL_PRODUCT_STRING="PROVES Flight Control Board v5e"

CONFIG_I2C_TCA954X=y
CONFIG_I2C_TCA954X_ROOT_INIT_PRIO=70
CONFIG_I2C_TCA954X_CHANNEL_INIT_PRIO=71

# DW I2C SCL timing is derived from this assumed IC clock (MHz). RP2350
# clocks I2C from CLK_SYS at 150 MHz; the default (32) yields ~520 kHz SCL
# instead of the intended 100 kHz. (rpi_pico sets 125 for the same reason.)
CONFIG_I2C_DW_CLOCK_SPEED=150

# Sensors
CONFIG_SENSOR=y
CONFIG_LSM6DSO=y
CONFIG_LSM6DSO_ENABLE_TEMP=y
CONFIG_LIS2MDL=y
CONFIG_INA219=y
CONFIG_TMP112=y
CONFIG_VEML6031=y

# Radio — USP path (SX1262, E22-400M30S)
# CONFIG_LORA is intentionally omitted: USP uses "semtech,sx1262-new" binding
# and LORA_BASICS_MODEM_DRIVERS depends on !LORA.  Exactly one driver binds.
CONFIG_LORA_BASICS_MODEM_DRIVERS=y
CONFIG_LORA_BASICS_MODEM_DRIVERS_RAL_RALF=y
CONFIG_LORA_BASICS_MODEM_DRIVERS_EVENT_TRIGGER_GLOBAL_THREAD=y
CONFIG_USP=y
# USP main thread: provides zephyr_usp_initialization_wait() + smtc_rac run loop.
# RalSessionImpl calls zephyr_usp_initialization_wait() before smtc_rac_open_radio().
CONFIG_USP_MAIN_THREAD=y

# RTC
CONFIG_RTC=y
CONFIG_RTC_RV3028=y
CONFIG_RTC_ALARM=y

# Bootloader settings
CONFIG_BOOTLOADER_MCUBOOT=y
CONFIG_MCUBOOT_BOOTUTIL_LIB=y
# Use an offset to swap images
CONFIG_MCUBOOT_BOOTLOADER_MODE_SWAP_USING_OFFSET=y
# Allow downgrade (fallback)
CONFIG_MCUBOOT_BOOTLOADER_NO_DOWNGRADE=n
# Hyper important. Adjust and fail.
CONFIG_ROM_END_OFFSET=0x1150
CONFIG_MCUBOOT_UPDATE_FOOTER_SIZE=0x1000

# Settings to allow flash image writes
CONFIG_FLASH=y
CONFIG_FLASH_MAP=y
CONFIG_STREAM_FLASH=y
CONFIG_IMG_MANAGER=y
```

## drivers/Kconfig
```kconfig
# SPDX-License-Identifier: Apache-2.0

menu "Device Drivers"

rsource "sx1280/Kconfig"

endmenu
```

## drivers/memc/Kconfig
```kconfig
# Copyright (c) 2025 BroncoSpace / PROVES Team
# SPDX-License-Identifier: Apache-2.0

config MEMC_RP2350_PSRAM
	bool "RP2350 QMI PSRAM driver (APMemory APS1604M)"
	default y
	depends on DT_HAS_RASPBERRYPI_RP2350_PSRAM_APS1604M_ENABLED
	select PINCTRL
	help
	  Enable the one-shot QMI memory-mapped driver for the APMemory
	  APS1604M-3SQR 2 MB QSPI PSRAM on RP2350 chip-select 1 (0x11000000).

	  The init function runs the PSRAM reset and RDID sequence entirely
	  from RAM (using __ramfunc) with interrupts locked so that QMI direct
	  mode does not stall instruction fetch from flash.

	  On successful init the PSRAM is accessible as ordinary memory at
	  [0x11000000, 0x11200000).

config MEMC_RP2350_PSRAM_SELF_TEST
	bool "Run full-region PSRAM memtest at boot"
	default y
	depends on MEMC_RP2350_PSRAM
	help
	  After the M1 window is programmed, run an address-in-address plus
	  inverted-pattern memtest across the whole PSRAM through the uncached
	  XIP alias.  Adds roughly a second to boot; a failure marks the PSRAM
	  not-ready (boot continues without it).

config MEMC_RP2350_PSRAM_INIT_PRIORITY
	int "PSRAM driver init priority"
	default 70
	depends on MEMC_RP2350_PSRAM
	help
	  POST_KERNEL init priority for the RP2350 PSRAM driver.  Must run
	  after pinctrl (default 45) and before any consumer that allocates
	  from the PSRAM heap.
```

## drivers/psram/Kconfig
```kconfig
# Copyright (c) 2025
# SPDX-License-Identifier: Apache-2.0

config PSRAM_APS1604M
	bool "APMemory APS1604M QSPI PSRAM"
	default y
	depends on DT_HAS_APS_APS1604M_ENABLED
	help
	  Enable driver for APMemory APS1604M 16Mbit (2MB) QSPI PSRAM.

config PSRAM_INIT_PRIORITY
	int "PSRAM driver init priority"
	default 70
	depends on PSRAM_APS1604M
	help
	  Init priority for the APS1604M PSRAM driver.

config PSRAM_LOG_LEVEL
	int "APS1604M PSRAM log level"
	default 3
	depends on PSRAM_APS1604M
	help
	  Log level for the APS1604M driver (0-4).

config PSRAM_APS1604M_RAW_TEST
	bool "Run raw PSRAM test (write then read over SPI, no driver)"
	default n
	depends on SPI
	help
	  At APPLICATION init: write 4 bytes at address 0, then read 4 bytes back.
	  Use to see what happens when talking to the chip (no full driver).
	  Requires PSRAM on an SPI bus: add -DOVERLAY=psram_spi_test.overlay and
	  wire PSRAM to SPI0 CS1 (or edit overlay for your SPI/CS).
```

## drivers/sx1280/Kconfig
```kconfig
# SPDX-License-Identifier: Apache-2.0

config SX1280
	bool "Semtech SX1280 2.4GHz LoRa transceiver"
	default y
	depends on DT_HAS_SEMTECH_SX1280_ENABLED
	depends on SPI
	select GPIO
	help
	  Enable driver for Semtech SX1280 2.4GHz LoRa transceiver.

if SX1280

config SX1280_INIT_PRIORITY
	int "SX1280 driver initialization priority"
	default 80
	help
	  Initialization priority for the SX1280 driver. Must be greater
	  than SPI and GPIO initialization priorities.

module = SX1280
module-str = sx1280
source "subsys/logging/Kconfig.template.log_config"

endif # SX1280
```

## dts/bindings/memc/raspberrypi,rp2350-psram-aps1604m.yaml
```yaml
# Copyright (c) 2025 BroncoSpace / PROVES Team
# SPDX-License-Identifier: Apache-2.0

description: |
  APMemory APS1604M-3SQR 16 Mbit (2 MB) QSPI PSRAM attached to the
  RP2350 QMI chip-select 1 (XIP CS1 window, base 0x11000000).

  The device is memory-mapped via the QMI M1 registers after a one-shot
  init sequence (reset + RDID + Enter-Quad). The driver must run the
  direct-mode setup window from RAM (__ramfunc) with interrupts locked to
  avoid stalling instruction fetch from flash.

compatible: "raspberrypi,rp2350-psram-aps1604m"

include: [base.yaml, pinctrl-device.yaml]

properties:
  reg:
    required: true
    description: |
      Base address and size of the XIP CS1 window.
      Must be <0x11000000 DT_SIZE_M(2)> for the APS1604M-3SQR (2 MB).

  max-frequency:
    type: int
    required: true
    description: |
      Maximum QSPI clock frequency in Hz. The APS1604M-3SQR quad-mode
      maximum is 84 MHz (84000000). The driver picks the fastest safe
      divisor that does not exceed this value.
```

## dts/bindings/memory-controllers/aps,aps1604m-qmi.yaml
```yaml
# Copyright (c) 2025
# SPDX-License-Identifier: Apache-2.0
#
# APS1604M when used as a child of the QMI flash controller (e.g. RP2350).
# Same properties as aps,aps1604m; driver uses parent + cs-gpios instead of SPI bus.

include: aps,aps1604m.yaml

compatible: "aps,aps1604m-qmi"

description: |
  APMemory APS1604M 16Mbit (2MB) QSPI PSRAM when attached under the QMI flash controller.
  Use this compatible when the node is a child of raspberrypi,pico-flash-controller.
```

## dts/bindings/memory-controllers/aps,aps1604m.yaml
```yaml
# Copyright (c) 2025
# SPDX-License-Identifier: Apache-2.0

description: |
  APMemory APS1604M 16Mbit (2MB) QSPI PSRAM.
  Typically used as a child of a QSPI/flash controller (e.g. raspberrypi,pico-flash-controller).

compatible: "aps,aps1604m"

include: [base.yaml, pinctrl-device.yaml]

properties:
  reg:
    required: true
    description: Chip-select (address) and size in bytes (address-cells, size-cells from parent).

  cs-gpios:
    type: phandle-array
    description: |
      Chip select GPIO for this device (e.g. CE#). When the parent controller
      does not drive CS, the driver uses this pin to assert/deassert around transfers.
      Typically one entry, e.g. cs-gpios = <&gpio0 8 GPIO_ACTIVE_LOW>.

  spi-max-frequency:
    type: int
    description: Maximum SPI/QSPI clock frequency in Hz (e.g. 84000000 for 84 MHz).

  size:
    type: int
    description: |
      Memory size in bytes. Use when parent has no size-cells (e.g. under SPI bus
      where reg is only chip-select). For APS1604M use 2097152 (2MB).
```

## dts/bindings/radio/semtech,sx1280.yaml
```yaml
# SPDX-License-Identifier: Apache-2.0

description: Semtech SX1280 2.4GHz LoRa transceiver

compatible: "semtech,sx1280"

include: [spi-device.yaml, pinctrl-device.yaml]

properties:
  reset-gpios:
    type: phandle-array
    required: true
    description: |
      GPIO connected to the RESET pin (active low).
      This pin is used to reset the radio module.

  busy-gpios:
    type: phandle-array
    required: false
    description: |
      GPIO connected to the BUSY pin.
      This pin indicates when the radio is busy processing.

  dio1-gpios:
    type: phandle-array
    required: true
    description: |
      GPIO connected to the DIO1 interrupt pin.
      This pin signals various radio events (RX done, TX done, etc.).

  dio2-gpios:
    type: phandle-array
    required: false
    description: |
      GPIO connected to the DIO2 interrupt pin.
      Optional secondary interrupt pin.

  dio3-gpios:
    type: phandle-array
    required: false
    description: |
      GPIO connected to the DIO3 interrupt pin.
      Optional tertiary interrupt pin.

  tcxo-power-startup-delay-ms:
    type: int
    default: 10
    description: |
      Delay in milliseconds to wait for TCXO to stabilize after power-up.

  tx-enable-gpios:
    type: phandle-array
    required: false
    description: |
      GPIO to enable TX path (for external PA control).

  rx-enable-gpios:
    type: phandle-array
    required: false
    description: |
      GPIO to enable RX path (for external LNA control).
```
